## assets/br2-external/configs/ohmlatl_defconfig
```kconfig
BR2_x86_64=y
BR2_TOOLCHAIN_BUILDROOT_MUSL=y
BR2_KERNEL_HEADERS_6_18=y
BR2_CCACHE=y
BR2_REPRODUCIBLE=y
BR2_INIT_NONE=y
BR2_SYSTEM_BIN_SH_BUSYBOX=y
# BR2_TARGET_GENERIC_GETTY is not set
BR2_ROOTFS_OVERLAY="$(BR2_EXTERNAL_OHMLATL_PATH)/board/ohmlatl/overlay"
BR2_ROOTFS_POST_BUILD_SCRIPT="$(BR2_EXTERNAL_OHMLATL_PATH)/board/ohmlatl/post-build.sh"
BR2_LINUX_KERNEL=y
BR2_LINUX_KERNEL_CUSTOM_VERSION=y
BR2_LINUX_KERNEL_CUSTOM_VERSION_VALUE="6.18.33"
BR2_LINUX_KERNEL_USE_CUSTOM_CONFIG=y
BR2_LINUX_KERNEL_CUSTOM_CONFIG_FILE="$(BR2_EXTERNAL_OHMLATL_PATH)/board/ohmlatl/linux-firecracker-6.18.config"
BR2_LINUX_KERNEL_CONFIG_FRAGMENT_FILES="$(BR2_EXTERNAL_OHMLATL_PATH)/board/ohmlatl/linux.fragment"
BR2_LINUX_KERNEL_VMLINUX=y
BR2_LINUX_KERNEL_NEEDS_HOST_OPENSSL=y
BR2_LINUX_KERNEL_NEEDS_HOST_LIBELF=y
BR2_PACKAGE_BUSYBOX=y
BR2_PACKAGE_CRYPTSETUP=y
BR2_PACKAGE_E2FSPROGS=y
BR2_TARGET_ROOTFS_CPIO=y
BR2_TARGET_ROOTFS_CPIO_GZIP=y
# BR2_TARGET_ROOTFS_TAR is not set
```
